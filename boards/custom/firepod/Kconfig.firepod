## boards/custom/firepod/Kconfig.firepod
```kconfig
# defines the BOARD_FIREPOD symbol and selects the stm32 chip that we are using

config BOARD_FIREPOD
	select SOC_STM32L432XX
```

## boards/custom/firepod/firepod_defconfig
```kconfig
# TODO: figure these first 4 out out for the stm32l4
CONFIG_MAIN_STACK_SIZE=2048
CONFIG_CLOCK_CONTROL=y 
CONFIG_SYS_CLOCK_EXISTS=y
CONFIG_SYS_CLOCK_HW_CYCLES_PER_SEC=80000000

CONFIG_CONSOLE=y
CONFIG_SERIAL=y
CONFIG_UART_CONSOLE=y
CONFIG_GPIO=y
```
